## arch/riscv/kvm/Kconfig
```kconfig
# SPDX-License-Identifier: GPL-2.0
#
# KVM configuration
#

source "virt/kvm/Kconfig"

menuconfig VIRTUALIZATION
	bool "Virtualization"
	help
	  Say Y here to get to see options for using your Linux host to run
	  other operating systems inside virtual machines (guests).
	  This option alone does not add any kernel code.

	  If you say N, all options in this submenu will be skipped and
	  disabled.

if VIRTUALIZATION

config KVM
	tristate "Kernel-based Virtual Machine (KVM) support (EXPERIMENTAL)"
	depends on RISCV_SBI && MMU
	select HAVE_KVM_IRQCHIP
	select HAVE_KVM_IRQ_ROUTING
	select HAVE_KVM_MSI
	select HAVE_KVM_VCPU_ASYNC_IOCTL
	select HAVE_KVM_READONLY_MEM
	select KVM_COMMON
	select KVM_GENERIC_DIRTYLOG_READ_PROTECT
	select KVM_GENERIC_HARDWARE_ENABLING
	select KVM_MMIO
	select KVM_XFER_TO_GUEST_WORK
	select KVM_GENERIC_MMU_NOTIFIER
	select SCHED_INFO
	help
	  Support hosting virtualized guest machines.

	  If unsure, say N.

config RISCV_PVM_HOST
	bool "Experimental U-mode PVM host backend"
	depends on KVM=y && 64BIT && FPU
	help
	  Select a software PVM backend instead of the H-extension backend.
	  Runs a single-hart Sv39 guest kernel and its processes in U-mode
	  under the S-mode Linux host. Uses /dev/kvm, owned shadow tables,
	  a supervisor trampoline and SBI console/timer services.
	  This experimental backend does not require the H extension.

endif # VIRTUALIZATION
```
